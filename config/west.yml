## config/west.yml
```yaml
manifest:
  remotes:
    - name: zmkfirmware
      url-base: https://github.com/zmkfirmware
    - name: my_fork
      url-base: https://github.com/invrtd/
  projects:
    - name: zmk
      remote: my_fork
      revision: nice!view-180
      import: app/west.yml
  self:
    path: config
```
